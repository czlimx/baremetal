; H616 CORTEX-A53 * 4 configurations

; Core config
SYStem.CPU ARMV8-A
SYStem.CONFIG.CoreNumber 4
CORE.NUMBER 4
CORE.ASSIGN 1. 2. 3. 4.
SYStem.Option RESBREAK OFF
SYStem.Option EnReset OFF
SYStem.Option TRST OFF
SYSTEM.JTAGCLOCK CTCK 10MHz
TrOnchip.StepVector ON

;; mem-access
SYStem.CONFIG.memoryaccessport 0
SYStem.CONFIG.debugaccessport 1

;; DBG
SYStem.CONFIG.COREDEBUG.Base 0x81410000
SYStem.CONFIG.CTI.Base 0x81420000
SYStem.CONFIG.BMC.Base 0x81430000
SYStem.CONFIG.ETM.Base 0x81440000

SYStem.Attach
Break

;;Disable watchdog
Data.Set MD:0x030090B4 %LE %Long 0x0
Data.Set MD:0x030090B8 %LE %Long 0x0

; Load the application
;Data.LOAD.Elf "&DEMO_SCRIPT_DIR/../armv8"
;Wait 100ms
;Data.LOAD.Elf "&DEMO_SCRIPT_DIR/../armv7" /PATH \\wsl.localhost\Ubuntu
;Go

;set MMIO->RVBAR
;Data.Set MD:0x9010040 %LE %Long 0x00020000
;DSB
;Data.Set c15:0x4A7 %Long 0x0
;ISB
;Data.Set c15:0x457 %Long 0x0
;warm reset to switch AArch64
;Data.Set c15:0x20C  %Long 0x3
;DMB
;Data.Set c15:0x5A7 %Long 0x0
;ISB
;Data.Set c15:0x457 %Long 0x0
;WFI
;Data.Set C15:0x407 %Long 0x0
;Data.LOAD.Elf "&DEMO_SCRIPT_DIR/../armv7" /PATH \\wsl.localhost\Ubuntu
