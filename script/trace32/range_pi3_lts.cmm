; H616 CORTEX-A53 * 4 configurations
PRIVATE &DEMO_SCRIPT_DIR &AUX_SCRIPT_DIR
&DEMO_SCRIPT_DIR=OS.PPD()

; Core config
SYStem.CPU ARMV8-A
SYStem.CONFIG.CoreNumber 4
CORE.NUMBER 4
CORE.ASSIGN 1. 2. 3. 4.
SYStem.Option RESBREAK OFF
SYStem.Option EnReset OFF
SYStem.Option TRST OFF
SYSTEM.JTAGCLOCK CTCK 10MHz
TrOnchip.StepVector ON

;; mem-access
SYStem.CONFIG.memoryaccessport 0
SYStem.CONFIG.debugaccessport 1

;; DBG
SYStem.CONFIG.COREDEBUG.Base 0x81410000
SYStem.CONFIG.CTI.Base 0x81420000
SYStem.CONFIG.BMC.Base 0x81430000
SYStem.CONFIG.ETM.Base 0x81440000

SYStem.Attach
Break

;;Disable watchdog
Data.Set MD:0x030090B4 %LE %Long 0x0
Data.Set MD:0x030090B8 %LE %Long 0x0

; Load the application
Data.LOAD.Elf "&DEMO_SCRIPT_DIR/../../bin/h616.elf" /LOADSEC !.bss /PATH \\wsl.localhost\Ubuntu
