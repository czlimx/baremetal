; --------------------------------------------------------------------------------
; @Props: NoMetaTags
; @Description:
;     Helper script to configure Phase Locked Loops (PLLs) of AM625X
; @Author: CMO
; @Copyright: (C) 1989-2022 Lauterbach GmbH, licensed for use with TRACE32(R) only
; --------------------------------------------------------------------------------
; $Id: configure_pll.cmm 19965 2022-10-21 13:10:58Z cmorgenstern $

LOCAL &PARAM_PLL
ENTRY &PARAM_PLL %LINE &SUB_PARAMS

; PLL module constants
LOCAL &_PLL0_CFG_BASE &_MCU_PLL0_CFG_BASE &_PLL_INSTANCE_OFFSET
&_PLL0_CFG_BASE=0x680000
&_MCU_PLL0_CFG_BASE=0x4040000
&_PLL_INSTANCE_OFFSET=0x1000

; PLL register offset constants
LOCAL &_PLL_HSDIV_CTRL0 &_PLL_LOCKKEY0 &_PLL_LOCKKEY1 &_PLL_CTRL &_PLL_FREQ_CTRL0 &_PLL_FREQ_CTRL1 &_PLL_DIV_CTRL
&_PLL_LOCKKEY0=0x10
&_PLL_LOCKKEY1=0x14
&_PLL_CTRL=0x20
&_PLL_FREQ_CTRL0=0x30
&_PLL_FREQ_CTRL1=0x34
&_PLL_DIV_CTRL=0x38
&_PLL_HSDIV_CTRL0=0x80

; Shared script variables to hold information about currently selected PLL
LOCAL &PLL_BASE &PLL_NUM

; helper vaiarbels
LOCAL &_SCRIPTNAME
&_SCRIPTNAME=OS.PPF()
&_SCRIPTNAME=OS.FILE.NAME(&_SCRIPTNAME)


IF ("&PARAM_PLL"=="MAIN")
(
	GOSUB CONFIG_MAIN_PLL0
	ENDDO
)
ELSE IF ("&PARAM_PLL"=="PER0")
(
	GOSUB CONFIG_PER0_PLL
	ENDDO
)
ELSE IF ("&PARAM_PLL"=="PER1")
(
	GOSUB CONFIG_PER1_PLL
	ENDDO
)
ELSE IF ("&PARAM_PLL"=="MCU0")
(
	GOSUB CONFIG_MCU_PLL0
	ENDDO
)
ELSE IF ("&PARAM_PLL"=="A53")
(
	GOSUB CONFIG_ARM0_PLL
	ENDDO
)
ELSE IF ("&PARAM_PLL"=="DDRBASE")
(
	GOSUB CONFIG_DDR_BASE_PLL
	ENDDO
)
ELSE IF ("&PARAM_PLL"=="DDR400")
(
	GOSUB CONFIG_DDR400_PLL
	ENDDO
)
ELSE IF ("&PARAM_PLL"=="SMS")
(
	GOSUB CONFIG_SMS_PLL
	ENDDO
)
ELSE IF ("&PARAM_PLL"=="DSS0")
(
	GOSUB CONFIG_DSS0_PLL
	ENDDO
)
ELSE IF ("&PARAM_PLL"=="DSS1")
(
	GOSUB CONFIG_DSS1_PLL
	ENDDO
)
ELSE IF ("&PARAM_PLL"=="_CFG_")
(
	; Special command to access script internal configuration routines

	; Special command parameters must be given in the following order:
	; _CFG_ <cmd> <pll_domain> <pll_number> [<param0> <param1> ...]

	PRIVATE &SUB_PARAMS_FORMATED &CFG_CMD &BASE &NUM &PARAM0 &PARAM1 &PARAM2 &PARAM3 &PARAM4

	; Remove unnecessary whitespaces
	&SUB_PARAMS_FORMATED=STRing.TRIM("&SUB_PARAMS")
	RePeaT
	(
		&SUB_PARAMS="&SUB_PARAMS_FORMATED"
		&SUB_PARAMS_FORMATED=STRing.Replace("&SUB_PARAMS","  "," ",0.)
	)
	WHILE ("&SUB_PARAMS_FORMATED"!="&SUB_PARAMS")

	; Extract command and parameters
	&CFG_CMD=STRing.SPLIT("&SUB_PARAMS"," ",0)
	&PLLDOM=STRing.SPLIT("&SUB_PARAMS"," ",1)
	&PLLNUM=STRing.SPLIT("&SUB_PARAMS"," ",2)
	&PARAM0=STRing.SPLIT("&SUB_PARAMS"," ",3)
	&PARAM1=STRing.SPLIT("&SUB_PARAMS"," ",4)
	&PARAM2=STRing.SPLIT("&SUB_PARAMS"," ",5)
	&PARAM3=STRing.SPLIT("&SUB_PARAMS"," ",6)
	&PARAM4=STRing.SPLIT("&SUB_PARAMS"," ",7)

	; Set shared script variables
	&PLL_NUM=&PLLNUM
	IF ("&PLLDOM"=="MCU")
	(
		&PLL_BASE=&_MCU_PLL0_CFG_BASE
	)
	ELSE IF ("&PLLDOM"=="MAIN")
	(
		&PLL_BASE=&_PLL0_CFG_BASE
	)
	ELSE
	(
		PRINT %WARNING "&_SCRIPTNAME: Unknown PLL domain: &PLLDOM"
		ENDDO
	)

	IF ("&CFG_CMD"=="BYPASS")
	(
		GOSUB BYPASS_CONFIG_PLL_CLOCK
	)
	ELSE IF ("&CFG_CMD"=="DIV")
	(
		//    CONFIG_PLL_CLOCK_DIV &REF_DIV &POST_DIV1 &POST_DIV2 &FB_DIV_INT &FB_DIV_FRAC
		GOSUB CONFIG_PLL_CLOCK_DIV &PARAM0 &PARAM1 &PARAM2 &PARAM3 &PARAM4
	)
	ELSE IF ("&CFG_CMD"=="HSDIV")
	(
		//    CONFIG_PLL_CLOCK_HSDIV &HSDIV_NUM &HSDIV_VALUE
		GOSUB CONFIG_PLL_CLOCK_HSDIV &PARAM0 &PARAM1
	)
	ELSE IF ("&CFG_CMD"=="ENABLE")
	(
		GOSUB ENABLE_PLL_CLOCK
	)
	ELSE
	(
		PRINT %WARNING "&_SCRIPTNAME: Unknown PLL configuration step: &CFG_CMD"
		ENDDO
	)
)
ELSE
(
	PRINT %WARNING "&_SCRIPTNAME: Failed to configure PLL. Unknown PLL descriptor: &PARAM_PLL"
)

ENDDO


; --------------------------------------------------------------------------------
; Individual domain configuration subroutines

CONFIG_MAIN_PLL0:
	&PLL_BASE=&_PLL0_CFG_BASE
	&PLL_NUM=0.
	GOSUB BYPASS_CONFIG_PLL_CLOCK
	GOSUB CONFIG_PLL_CLOCK_DIV   1. 2. 1. 80. 1.    // &REF_DIV &POST_DIV1 &POST_DIV2 &FB_DIV_INT &FB_DIV_FRAC
	GOSUB CONFIG_PLL_CLOCK_HSDIV 0. 3.     // &HSDIV_NUM &HSDIV_VALUE
	GOSUB CONFIG_PLL_CLOCK_HSDIV 1. 9.
	GOSUB CONFIG_PLL_CLOCK_HSDIV 2. 9.
	GOSUB CONFIG_PLL_CLOCK_HSDIV 3. 14.
	GOSUB CONFIG_PLL_CLOCK_HSDIV 4. 24.
	GOSUB CONFIG_PLL_CLOCK_HSDIV 5. 4.
	GOSUB CONFIG_PLL_CLOCK_HSDIV 6. 3.
	GOSUB CONFIG_PLL_CLOCK_HSDIV 7. 3.
	GOSUB CONFIG_PLL_CLOCK_HSDIV 8. 19.
	GOSUB CONFIG_PLL_CLOCK_HSDIV 9. 2.

	; PLLCTRL0 settings (Base: 0x410000)
	Data.Set EZAXI:0x410100 %Long 0x00000048
	Data.Set EZAXI:0x41012C %Long 0x00000000
	Data.Set EZAXI:0x410124 %Long 0x00008000
	Data.Set EZAXI:0x410138 %Long 0x00000000
	Data.Set EZAXI:0x410118 %Long 0x00008001
	Data.Set EZAXI:0x410140 %Long 0x00000002
	Data.Set EZAXI:0x410104 %Long 0x00000012
	Data.Set EZAXI:0x410148 %Long 0x00000002
	Data.Set EZAXI:0x410138 %Long 0x00000001
	Data.Set EZAXI:0x410100 %Long 0x00000049
	Data.Set EZAXI:0x410138 %Long 0x00000000
	Data.Set EZAXI:0x410100 %Long 0x00000041

	GOSUB ENABLE_PLL_CLOCK
	RETURN


CONFIG_PER0_PLL:
	&PLL_BASE=&_PLL0_CFG_BASE
	&PLL_NUM=1.
	GOSUB BYPASS_CONFIG_PLL_CLOCK
	GOSUB CONFIG_PLL_CLOCK_DIV   1. 2. 1. 76. 0xCCCCCC    // &REF_DIV &POST_DIV1 &POST_DIV2 &FB_DIV_INT &FB_DIV_FRAC
	GOSUB CONFIG_PLL_CLOCK_HSDIV 0. 9.     // &HSDIV_NUM &HSDIV_VALUE
	GOSUB CONFIG_PLL_CLOCK_HSDIV 1. 11.
	GOSUB CONFIG_PLL_CLOCK_HSDIV 2. 9.
	GOSUB CONFIG_PLL_CLOCK_HSDIV 3. 9.
	GOSUB CONFIG_PLL_CLOCK_HSDIV 5. 5.
	GOSUB CONFIG_PLL_CLOCK_HSDIV 6. 9.

	GOSUB ENABLE_PLL_CLOCK
	RETURN

CONFIG_PER1_PLL:
	&PLL_BASE=&_PLL0_CFG_BASE
	&PLL_NUM=2.
	GOSUB BYPASS_CONFIG_PLL_CLOCK
	GOSUB CONFIG_PLL_CLOCK_DIV   1. 1. 1. 80. -1.    // &REF_DIV &POST_DIV1 &POST_DIV2 &FB_DIV_INT &FB_DIV_FRAC
	GOSUB CONFIG_PLL_CLOCK_HSDIV 0. 5.     // &HSDIV_NUM &HSDIV_VALUE
	GOSUB CONFIG_PLL_CLOCK_HSDIV 1. 7.
	GOSUB CONFIG_PLL_CLOCK_HSDIV 2. 9.
	GOSUB CONFIG_PLL_CLOCK_HSDIV 3. 5.
	GOSUB CONFIG_PLL_CLOCK_HSDIV 4. 3.
	GOSUB CONFIG_PLL_CLOCK_HSDIV 5. 3.
	GOSUB CONFIG_PLL_CLOCK_HSDIV 6. 3.
	GOSUB CONFIG_PLL_CLOCK_HSDIV 7. 9.
	GOSUB CONFIG_PLL_CLOCK_HSDIV 8. 9.
	GOSUB CONFIG_PLL_CLOCK_HSDIV 9. 19.


	GOSUB ENABLE_PLL_CLOCK
	RETURN


CONFIG_MCU_PLL0:
	&PLL_BASE=&_MCU_PLL0_CFG_BASE
	&PLL_NUM=0.

	GOSUB BYPASS_CONFIG_PLL_CLOCK
	GOSUB CONFIG_PLL_CLOCK_DIV   1. 1. 1. 96. -1.    // &REF_DIV &POST_DIV1 &POST_DIV2 &FB_DIV_INT &FB_DIV_FRAC
	GOSUB CONFIG_PLL_CLOCK_HSDIV 0. 5.     // &HSDIV_NUM &HSDIV_VALUE
	GOSUB CONFIG_PLL_CLOCK_HSDIV 1. 24.
	GOSUB CONFIG_PLL_CLOCK_HSDIV 2. 24.
	GOSUB CONFIG_PLL_CLOCK_HSDIV 3. 11.
	GOSUB CONFIG_PLL_CLOCK_HSDIV 4. 29.

	; MCU_PLLCTRL0 settings (Base: 0x4020000)
	Data.Set EZAXI:0x4020100 %Long 0x00000048
	Data.Set EZAXI:0x402012C %Long 0x00000000
	Data.Set EZAXI:0x4020124 %Long 0x00008000
	Data.Set EZAXI:0x4020138 %Long 0x00000000
	Data.Set EZAXI:0x4020118 %Long 0x00008001
	Data.Set EZAXI:0x4020140 %Long 0x00000002
	Data.Set EZAXI:0x4020104 %Long 0x00000012
	Data.Set EZAXI:0x4020148 %Long 0x00000002
	Data.Set EZAXI:0x4020138 %Long 0x00000001
	Data.Set EZAXI:0x4020100 %Long 0x00000049
	Data.Set EZAXI:0x4020138 %Long 0x00000000
	Data.Set EZAXI:0x4020100 %Long 0x00000041

	GOSUB ENABLE_PLL_CLOCK
	RETURN

CONFIG_ARM0_PLL:
	; Cortex-A53
	&PLL_BASE=&_PLL0_CFG_BASE
	&PLL_NUM=8.
	GOSUB BYPASS_CONFIG_PLL_CLOCK
	GOSUB CONFIG_PLL_CLOCK_DIV   1. 1. 1. 96. -1.        // &REF_DIV &POST_DIV1 &POST_DIV2 &FB_DIV_INT &FB_DIV_FRAC
	GOSUB CONFIG_PLL_CLOCK_HSDIV 0. 1.     // &HSDIV_NUM &HSDIV_VALUE
	GOSUB ENABLE_PLL_CLOCK
	RETURN

CONFIG_DDR_BASE_PLL:
	&PLL_BASE=&_PLL0_CFG_BASE
	&PLL_NUM=12.
	GOSUB BYPASS_CONFIG_PLL_CLOCK
	GOSUB CONFIG_PLL_CLOCK_DIV   1. 1. 1. 64. -1.    // &REF_DIV &POST_DIV1 &POST_DIV2 &FB_DIV_INT &FB_DIV_FRAC
	GOSUB CONFIG_PLL_CLOCK_HSDIV 0. 2.     // &HSDIV_NUM &HSDIV_VALUE
	GOSUB ENABLE_PLL_CLOCK
	RETURN

CONFIG_DDR400_PLL:    ; applied during DDR setup
	&PLL_BASE=&_PLL0_CFG_BASE
	&PLL_NUM=12.
	PRIVATE &registerBase &FB_DIV_INT
	&registerBase=&PLL_BASE+&PLL_NUM*&_PLL_INSTANCE_OFFSET
	&FB_DIV_INT=0x40
	Data.Set EZAXI:(&registerBase+&_PLL_FREQ_CTRL0) %Long (&FB_DIV_INT&0xfff)
	GOSUB CONFIG_PLL_CLOCK_HSDIV 0. 3.     // &HSDIV_NUM &HSDIV_VALUE
	RETURN

CONFIG_SMS_PLL:
	&PLL_BASE=&_PLL0_CFG_BASE
	&PLL_NUM=15.
	GOSUB BYPASS_CONFIG_PLL_CLOCK
	GOSUB CONFIG_PLL_CLOCK_DIV   1. 1. 1. 80. -1.    // &REF_DIV &POST_DIV1 &POST_DIV2 &FB_DIV_INT &FB_DIV_FRAC
	GOSUB CONFIG_PLL_CLOCK_HSDIV 0. 4.     // &HSDIV_NUM &HSDIV_VALUE
	GOSUB CONFIG_PLL_CLOCK_HSDIV 1. 4.     // &HSDIV_NUM &HSDIV_VALUE
	GOSUB ENABLE_PLL_CLOCK
	RETURN

CONFIG_DSS0_PLL:
	&PLL_BASE=&_PLL0_CFG_BASE
	&PLL_NUM=16.
	GOSUB BYPASS_CONFIG_PLL_CLOCK
	GOSUB CONFIG_PLL_CLOCK_DIV   1. 1. 1. 95. 0x333333    // &REF_DIV &POST_DIV1 &POST_DIV2 &FB_DIV_INT &FB_DIV_FRAC
	GOSUB CONFIG_PLL_CLOCK_HSDIV 0. 1.     // &HSDIV_NUM &HSDIV_VALUE
	GOSUB ENABLE_PLL_CLOCK
	RETURN

CONFIG_DSS1_PLL:
	&PLL_BASE=&_PLL0_CFG_BASE
	&PLL_NUM=17.
	GOSUB BYPASS_CONFIG_PLL_CLOCK
	GOSUB CONFIG_PLL_CLOCK_DIV   1. 1. 1. 81. 0x999999    // &REF_DIV &POST_DIV1 &POST_DIV2 &FB_DIV_INT &FB_DIV_FRAC
	GOSUB CONFIG_PLL_CLOCK_HSDIV 0. 11.     // &HSDIV_NUM &HSDIV_VALUE
	GOSUB ENABLE_PLL_CLOCK
	RETURN


; Helper functions

BYPASS_CONFIG_PLL_CLOCK:
(
	PRIVATE &registerBase &bypass
	&registerBase=&PLL_BASE+&PLL_NUM*&_PLL_INSTANCE_OFFSET
	&bypass=0x80000000

	; Unlock registers, set PLL into bypass mode and disable PLL
	Data.Set EZAXI:(&registerBase+&_PLL_LOCKKEY0) %Long 0x68EF3490
	Data.Set EZAXI:(&registerBase+&_PLL_LOCKKEY1) %Long 0xD172BC5A
	Data.Set EZAXI:(&registerBase+&_PLL_CTRL)     %Long (&bypass|Data.Long(EZAXI:(&registerBase+&_PLL_CTRL)))
	wait 1.ms
	Data.Set EZAXI:(&registerBase+&_PLL_CTRL)     %Long 0x80010013
	RETURN
)

CONFIG_PLL_CLOCK_DIV:
(
	PRIVATE &REF_DIV &POST_DIV1 &POST_DIV2 &FB_DIV_INT &FB_DIV_FRAC
	ENTRY   &REF_DIV &POST_DIV1 &POST_DIV2 &FB_DIV_INT &FB_DIV_FRAC

	PRIVATE &registerBase &divider
	&registerBase=&PLL_BASE+&PLL_NUM*&_PLL_INSTANCE_OFFSET

	&divider=(&REF_DIV&0x3f)|((&POST_DIV1&0x7)<<16.)|((&POST_DIV2&0x3)<<24.)
	Data.Set EZAXI:(&registerBase+&_PLL_DIV_CTRL)   %Long &divider
	Data.Set EZAXI:(&registerBase+&_PLL_FREQ_CTRL0) %Long (&FB_DIV_INT&0xfff)
	IF (&FB_DIV_FRAC!=-1.)
		Data.Set EZAXI:(&registerBase+&_PLL_FREQ_CTRL1) %Long (&FB_DIV_FRAC&0xffffff)
	RETURN
)

CONFIG_PLL_CLOCK_HSDIV:
(
	PRIVATE &HSDIV_NUM &HSDIV_VALUE
	ENTRY   &HSDIV_NUM &HSDIV_VALUE

	PRIVATE &registerBase &divider &hsdivReset &hsdivClockoutEn
	&registerBase=&PLL_BASE+&PLL_NUM*&_PLL_INSTANCE_OFFSET
	&hsdivReset=0x80000000
	&hsdivClockoutEn=0x8000

	&divider=&hsdivReset|&hsdivClockoutEn|(&HSDIV_VALUE&0x7f)
	Data.Set EZAXI:(&registerBase+&_PLL_HSDIV_CTRL0+0x4*&HSDIV_NUM) %Long &divider
	wait 1.ms
	&divider=&hsdivClockoutEn|(&HSDIV_VALUE&0x7f)
	Data.Set EZAXI:(&registerBase+&_PLL_HSDIV_CTRL0+0x4*&HSDIV_NUM) %Long &divider
	RETURN
)

ENABLE_PLL_CLOCK:
(
	PRIVATE &registerBase
	&registerBase=&PLL_BASE+&PLL_NUM*&_PLL_INSTANCE_OFFSET

	wait 1.ms
	; Re-Enable PLL and disable bypass mode
	Data.Set EZAXI:(&registerBase+&_PLL_CTRL)     %Long 0x80018013
	Data.Set EZAXI:(&registerBase+&_PLL_CTRL)     %Long 0x18013
	RETURN
)
